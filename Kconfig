## Kconfig
```kconfig
menuconfig DRIVERS_HDF
    bool "HDF driver framework support"
    default n
    help
      Answer Y to enable Linux support HDF.

if DRIVERS_HDF
config HDF_SUPPORT_LEVEL
    int "Set HDF support level"
    default 2
    range 0 5
    depends on DRIVERS_HDF
    help
      Answer 1 on small OHOS, 2 on standard OHOS

source "drivers/hdf/khdf/platform/Kconfig"
source "drivers/hdf/khdf/test/Kconfig"
source "drivers/hdf/khdf/model/display/Kconfig"
source "drivers/hdf/khdf/model/input/Kconfig"
source "drivers/hdf/khdf/model/network/wifi/Kconfig"
source "drivers/hdf/khdf/model/network/bluetooth/Kconfig"
source "drivers/hdf/khdf/model/sensor/Kconfig"
source "drivers/hdf/khdf/model/storage/Kconfig"
source "drivers/hdf/khdf/model/usb/host/Kconfig"
source "drivers/hdf/khdf/model/usb/device/Kconfig"
source "drivers/hdf/khdf/model/audio/Kconfig"
source "drivers/hdf/khdf/model/misc/vibrator/Kconfig"
source "drivers/hdf/khdf/model/misc/dsoftbus/Kconfig"
source "drivers/hdf/khdf/model/misc/light/Kconfig"

endif
```

## model/audio/Kconfig
```kconfig
config DRIVERS_HDF_AUDIO
    bool "Enable HDF Audio driver"
    default n
    depends on DRIVERS_HDF
    help
        Answer Y to choice HDF Audio driver.
config DRIVERS_HDF_AUDIO_HI3516CODEC
    bool "Enable HDF Audio Codec driver"
    default n
    depends on DRIVERS_HDF_AUDIO
    help
        Answer Y to choice HDF Audio Codec driver.

config DRIVERS_HDF_AUDIO_RK3568
    bool "Enable HDF Audio Codec driver"
    default n
    depends on DRIVERS_HDF_AUDIO
    help
        Answer Y to choice HDF Audio Codec driver.

config DRIVERS_HDF_AUDIO_ANA_HEADSET
    bool "Audio Headset support"
    default n
    depends on DRIVERS_HDF_AUDIO_RK3568
    help
        Audio Headset support:
            support hook interrupt mode.
            support hook adc mode.

config DRIVERS_HDF_AUDIO_TEST
    bool "Enable HDF Audio driver Test"
    default n
    depends on DRIVERS_HDF_AUDIO
    help
        Answer Y to choice HDF Audio driver Test.
```

## model/network/wifi/Kconfig
```kconfig
config DRIVERS_HDF_WIFI
    bool "Enable HDF wifi"
    default n
    depends on DRIVERS_HDF && DRIVERS_HDF_PLATFORM_SDIO
    help
      Answer Y to enable HDF wifi.

config DRIVERS_HDF_WLAN_SDIO
    bool "Enable HDF wlan sdio bus"
    default n
    depends on DRIVERS_HDF_WIFI
    help
      Answer Y to support HDF wlan sdio bus

config DRIVERS_HDF_WLAN_USB
    bool "Enable HDF wlan usb bus"
    default n
    depends on DRIVERS_HDF_WIFI
    help
      Answer Y to support HDF wlan usb bus

config DRIVERS_HI3881
    bool "Enable hi3881"
    default n
    depends on DRIVERS_HDF_WIFI
    help
      Answer Y to enable hi3881 wifi chip driver.

config DRIVERS_HDF_NETDEV_EXT
    bool "Get Linux net device from HDF"
    default n
    help
      Get Linux net device from HDF

config DRIVERS_RTL8723DU
    bool "Enable Realtek 8723D USB WiFi(rtl8723du)"
    default n
    depends on DRIVERS_HDF_WIFI
    select DRIVERS_HDF_WLAN_USB
    select DRIVERS_HDF_NETDEV_EXT
    help
      Answer Y to enable rtl8723du wifi chip driver.

config AP6XXX_WIFI6_HDF
    tristate "support ap6xxx wifi6(80211ax) HDF"
    depends on DRIVERS_HDF_WIFI
    select CFG80211
    select MAC80211
    select DRIVERS_HDF_NETDEV_EXT
    help
      This driver supports wifi6 for ap6xxx HDF chipset.
      This driver uses the kernel's wireless extensions subsystem.
      If you choose to build a module, it'll be called dhd. Say M if unsure.
```

## model/sensor/Kconfig
```kconfig
# Copyright (c) 2021 Huawei Device Co., Ltd.
#
# This software is licensed under the terms of the GNU General Public
# License version 2, as published by the Free Software Foundation, and
# may be copied, distributed, and modified under those terms.
#
# This program is distributed in the hope that it will be useful,
# but WITHOUT ANY WARRANTY; without even the implied warranty of
# MERCHANTABILITY or FITNESS FOR A PARTICULAR PURPOSE. See the
# GNU General Public License for more details.

config DRIVERS_HDF_SENSOR
    bool "Enable HDF sensor driver"
    default n
    depends on DRIVERS_HDF
    help
      Answer Y to enable HDF sensor driver.

config DRIVERS_HDF_SENSOR_ACCEL
    bool "Enable HDF accel sensor driver"
    default n
    depends on DRIVERS_HDF_SENSOR
    help
      Answer Y to enable HDF accel sensor driver.
config DRIVERS_HDF_SENSOR_ACCEL_BMI160
    bool "Enable HDF accel bmi160 sensor driver"
    default n
    depends on DRIVERS_HDF_SENSOR_ACCEL
    help
      Answer Y to enable HDF accel bmi160 sensor driver.
config DRIVERS_HDF_SENSOR_ACCEL_MXC6655XA
    bool "Enable HDF accel mxc6655xa sensor driver"
    default n
    depends on DRIVERS_HDF_SENSOR_ACCEL
    help
      Answer Y to enable HDF accel mxc6655xa sensor driver.
config DRIVERS_HDF_SENSOR_PPG
    bool "Enable HDF ppg sensor driver"
    default n
    depends on DRIVERS_HDF_SENSOR
    help
      Answer Y to enable HDF ppg sensor driver.
config DRIVERS_HDF_SENSOR_PPG_CS1262
    bool "Enable HDF ppg ppg cs1262 sensor driver"
    default n
    depends on DRIVERS_HDF_SENSOR_PPG
    help
      Answer Y to enable HDF ppg ppg cs1262 sensor driver.
config DRIVERS_HDF_SENSOR_ALS
    bool "Enable HDF als sensor driver"
    default n
    depends on DRIVERS_HDF_SENSOR
    help
      Answer Y to enable HDF als sensor driver.
config DRIVERS_HDF_SENSOR_ALS_BH1745
    bool "Enable HDF als bh1745 sensor driver"
    default n
    depends on DRIVERS_HDF_SENSOR_ALS
    help
      Answer Y to enable HDF als bh1745 sensor driver.
config DRIVERS_HDF_SENSOR_GRAVITY
    bool "Enable HDF gravity sensor driver"
    default n
    depends on DRIVERS_HDF_SENSOR_ACCEL
    help
      Answer Y to enable HDF gravity sensor driver.
config DRIVERS_HDF_SENSOR_GYRO
    bool "Enable HDF gyro sensor driver"
    default n
    depends on DRIVERS_HDF_SENSOR
    help
      Answer Y to enable HDF gyro sensor driver.
config DRIVERS_HDF_SENSOR_GYRO_BMI160
    bool "Enable HDF gyro bmi160 sensor driver"
    default n
    depends on DRIVERS_HDF_SENSOR_GYRO
    help
      Answer Y to enable HDF gyro bmi160 sensor driver.
config DRIVERS_HDF_SENSOR_PEDOMETER
    bool "Enable HDF pedometer sensor driver"
    default n
    depends on DRIVERS_HDF_SENSOR
    help
      Answer Y to enable HDF pedometer sensor driver.
config DRIVERS_HDF_SENSOR_PEDOMETER_BMI160
    bool "Enable HDF pedometer bmi160 sensor driver"
    default n
    depends on DRIVERS_HDF_SENSOR_PEDOMETER
    help
      Answer Y to enable HDF pedometer bmi160 sensor driver.
config DRIVERS_HDF_SENSOR_BAROMETER
    bool "Enable HDF barometer sensor driver"
    default n
    depends on DRIVERS_HDF_SENSOR
    help
      Answer Y to enable HDF barometer sensor driver.
config DRIVERS_HDF_SENSOR_BAROMETER_BMP180
    bool "Enable HDF barometer bmp180 sensor driver"
    default n
    depends on DRIVERS_HDF_SENSOR_BAROMETER
    help
      Answer Y to enable HDF barometer bmp180 sensor driver.
config DRIVERS_HDF_SENSOR_HALL
    bool "Enable HDF hall sensor driver"
    default n
    depends on DRIVERS_HDF_SENSOR
    help
      Answer Y to enable HDF hall sensor driver.
config DRIVERS_HDF_SENSOR_HALL_AK8789
    bool "Enable HDF hall ak8789 sensor driver"
    default n
    depends on DRIVERS_HDF_SENSOR_HALL
    help
      Answer Y to enable HDF hall ak8789 sensor driver.
config DRIVERS_HDF_SENSOR_MAGNETIC
    bool "Enable HDF magnetic sensor driver"
    default n
    depends on DRIVERS_HDF_SENSOR
    help
      Answer Y to enable HDF magnetic sensor driver.
config DRIVERS_HDF_SENSOR_MAGNETIC_LSM303
    bool "Enable HDF magnetic lsm303 sensor driver"
    default n
    depends on DRIVERS_HDF_SENSOR_MAGNETIC
    help
      Answer Y to enable HDF magnetic lsm303 sensor driver.
config DRIVERS_HDF_SENSOR_PROXIMITY
    bool "Enable HDF proximity sensor driver"
    default n
    depends on DRIVERS_HDF_SENSOR
    help
      Answer Y to enable HDF proximity sensor driver.
config DRIVERS_HDF_SENSOR_PROXIMITY_APDS9960
    bool "Enable HDF proximity adps9960 sensor driver"
    default n
    depends on DRIVERS_HDF_SENSOR_PROXIMITY
    help
      Answer Y to enable HDF proximity apds9960 sensor driver.
```

## model/usb/device/Kconfig
```kconfig
config DRIVERS_HDF_USB_F_GENERIC
    bool "Enable F_GENERIC driver"
    default n
    depends on DRIVERS_HDF
    help
        Answer Y to choice HDF USB F_GENERIC driver.
```

## platform/pwm/driver/Kconfig
```kconfig
config PWM_HI35XX
    bool "hi35xx pwm driver"
    depends on PWM
    help
      Answer Y to enable hi35xx pwm driver.
```
